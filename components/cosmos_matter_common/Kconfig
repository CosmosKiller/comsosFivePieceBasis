## components/cosmos_matter_common/Kconfig
```kconfig
menu "Cosmos Matter Common"

    config FACTORY_RESET_BUTTON_GPIO
        int "Factory reset button GPIO"
        range 0 48
        default 9
        help
            Active-low long-press button for Matter factory reset.
            XIAO ESP32-C6 BOOT is GPIO9; XIAO ESP32-S3 Sense BOOT is GPIO0.

endmenu
```

## iotBedsideLamp/main/Kconfig.projbuild
```kconfig
menu "Bedside Lamp"

    config BEDSIDE_LAMP_LED_GPIO
        int "WS2812 data GPIO"
        default 8
        help
            GPIO for the addressable LED data line (DevKitC-1 MVP: GPIO8).

    config BEDSIDE_LAMP_USER_BUTTON_GPIO
        int "User button GPIO"
        default 20
        help
            Dedicated user button (toggle / scene cycle). Not used for factory reset.

    config BEDSIDE_LAMP_USER_LONG_PRESS_MS
        int "User button long-press time (ms) for scene cycle"
        default 1500
        range 500 4000
        help
            Long press on the user button cycles presets. Factory reset uses the
            global BUTTON_LONG_PRESS_TIME_MS on a separate GPIO.

endmenu
```

## iotDoorIntercom/main/Kconfig.projbuild
```kconfig
menu "iotDoorIntercom"

    config IOT_DOOR_INTERCOM_HTTPS_STREAM
        bool "Serve MJPEG /stream over HTTPS (esp_https_server)"
        default y
        help
            When enabled, GET /stream is served on port 443 with the embedded
            self-signed certificate (main/certs/). Disable only for lab
            bring-up over plain HTTP port 80.

endmenu
```
